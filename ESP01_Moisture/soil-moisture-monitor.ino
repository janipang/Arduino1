#include <Wire.h>
#include <Adafruit_GFX.h>
#include <Adafruit_SH110X.h>

#define TRIG_PIN 5         // ขา Trig ของ Ultrasonic
#define ECHO_PIN 18        // ขา Echo ของ Ultrasonic
#define BUZZER_PIN 19      // ขาเชื่อมต่อ Buzzer
#define SOIL_SENSOR_PIN 34 // พินที่เชื่อมต่อกับ AOUT ของ Soil Sensor
#define DRY_VALUE 3000     // ค่า Analog เมื่อดินแห้งสนิท
#define WET_VALUE 1200     // ค่า Analog เมื่อดินชื้นมาก
#define SCREEN_WIDTH 128
#define SCREEN_HEIGHT 64

Adafruit_SH1106G display(SCREEN_WIDTH, SCREEN_HEIGHT, &Wire, -1); // ใช้ -1 ถ้าไม่มีขา Reset
unsigned long time_now = 0;
unsigned long last_time = 0;

int display_image = 1;

unsigned long start_melody_time = 0;
int currentNote = 0;
bool melody_status = false;
int notes[] = {261, 261, 392, 392, 440, 440, 392, 349, 349, 330, 330, 294, 294, 262};    // C D E F G A B C
int duration[] = {400, 400, 400, 400, 400, 400, 800, 400, 400, 400, 400, 400, 400, 800}; // ระยะเวลาแต่ละโน้ต
int num_notes = sizeof(notes) / sizeof(notes[0]);
bool is_new_note = true;
bool is_tone_playing = true;

// 'epd_bitmap_yummy', 128x64px
const unsigned char epd_bitmap_yummy[] PROGMEM = {
    0xff, 0xff, 0xff, 0xff, 0xff, 0xff, 0xff, 0xff, 0xff, 0xff, 0xff, 0xff, 0xff, 0xff, 0xff, 0xff,
    0xff, 0xff, 0xff, 0xff, 0xff, 0xff, 0xff, 0xff, 0xff, 0xff, 0xff, 0xff, 0xff, 0xff, 0xff, 0xff,
    0xff, 0xff, 0xff, 0xff, 0xff, 0xff, 0xff, 0xff, 0xff, 0xff, 0xff, 0xff, 0xff, 0xff, 0xff, 0xff,
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    0xff, 0xff, 0xff, 0xff, 0xff, 0xff, 0xff, 0xff, 0xff, 0xff, 0xff, 0xff, 0xff, 0xff, 0xff, 0xff};

// 'epd_bitmap_love', 128x64px
const unsigned char epd_bitmap_love[] PROGMEM = {
    0xff, 0xff, 0xff, 0xff, 0xff, 0xff, 0xff, 0xff, 0xff, 0xff, 0xff, 0xff, 0xff, 0xff, 0xff, 0xff,
    0xff, 0xff, 0xff, 0xff, 0xff, 0xff, 0xff, 0xff, 0xff, 0xff, 0xff, 0xff, 0xff, 0xff, 0xff, 0xff,
    0xff, 0xff, 0xff, 0xff, 0xff, 0xff, 0xff, 0xff, 0xff, 0xff, 0xff, 0xff, 0xff, 0xff, 0xff, 0xff,
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    0xff, 0xff, 0xff, 0xff, 0xff, 0xff, 0xff, 0xff, 0xff, 0xff, 0xff, 0xff, 0xff, 0xff, 0xff, 0xff};

// 'ยิ้มกว้าง', 128x64px
const unsigned char epd_bitmap_bigsmile[] PROGMEM = {
    0xff, 0xff, 0xff, 0xff, 0xff, 0xff, 0xff, 0xff, 0xff, 0xff, 0xff, 0xff, 0xff, 0xff, 0xff, 0xff,
    0xff, 0xff, 0xff, 0xff, 0xff, 0xff, 0xff, 0xff, 0xff, 0xff, 0xff, 0xff, 0xff, 0xff, 0xff, 0xff,
    0xff, 0xff, 0xff, 0xff, 0xff, 0xff, 0xff, 0xff, 0xff, 0xff, 0xff, 0xff, 0xff, 0xff, 0xff, 0xff,
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    0xff, 0xff, 0xff, 0xff, 0xff, 0xff, 0xff, 0xff, 0xff, 0xff, 0xff, 0xff, 0xff, 0xff, 0xff, 0xff};

// 'ยิ้มมีคิ้ว', 128x64px
const unsigned char epd_bitmap_smilewithbrow[] PROGMEM = {
    0xff, 0xff, 0xff, 0xff, 0xff, 0xff, 0xff, 0xff, 0xff, 0xff, 0xff, 0xff, 0xff, 0xff, 0xff, 0xff,
    0xff, 0xff, 0xff, 0xff, 0xff, 0xff, 0xff, 0xff, 0xff, 0xff, 0xff, 0xff, 0xff, 0xff, 0xff, 0xff,
    0xff, 0xff, 0xff, 0xff, 0xff, 0xff, 0xff, 0xff, 0xff, 0xff, 0xff, 0xff, 0xff, 0xff, 0xff, 0xff,
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    0xff, 0xff, 0xff, 0xff, 0xff, 0xff, 0xff, 0xff, 0xff, 0xff, 0xff, 0xff, 0xff, 0xff, 0xff, 0xff};

// 'ร้องไห้', 128x64px
const unsigned char epd_bitmap_crying[] PROGMEM = {
    0xff, 0xff, 0xff, 0xff, 0xff, 0xff, 0xff, 0xff, 0xff, 0xff, 0xff, 0xff, 0xff, 0xff, 0xff, 0xff,
    0xff, 0xff, 0xff, 0xff, 0xff, 0xff, 0xff, 0xff, 0xff, 0xff, 0xff, 0xff, 0xff, 0xff, 0xff, 0xff,
    0xff, 0xff, 0xff, 0xff, 0xff, 0xff, 0xff, 0xff, 0xff, 0xff, 0xff, 0xff, 0xff, 0xff, 0xff, 0xff,
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    0xff, 0xff, 0xff, 0xff, 0xff, 0xff, 0xff, 0xff, 0xff, 0xff, 0xff, 0xff, 0xff, 0xff, 0xff, 0xff};

// 'เริ่มเครียด', 128x64px
const unsigned char epd_bitmap_worry[] PROGMEM = {
    0xff, 0xff, 0xff, 0xff, 0xff, 0xff, 0xff, 0xff, 0xff, 0xff, 0xff, 0xff, 0xff, 0xff, 0xff, 0xff,
    0xff, 0xff, 0xff, 0xff, 0xff, 0xff, 0xff, 0xff, 0xff, 0xff, 0xff, 0xff, 0xff, 0xff, 0xff, 0xff,
    0xff, 0xff, 0xff, 0xff, 0xff, 0xff, 0xff, 0xff, 0xff, 0xff, 0xff, 0xff, 0xff, 0xff, 0xff, 0xff,
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    0xff, 0xff, 0xff, 0xff, 0xff, 0xff, 0xff, 0xff, 0xff, 0xff, 0xff, 0xff, 0xff, 0xff, 0xff, 0xff};

// 'หน้าโกรธ', 128x64px
const unsigned char epd_bitmap_angry[] PROGMEM = {
    0xff, 0xff, 0xff, 0xff, 0xff, 0xff, 0xff, 0xff, 0xff, 0xff, 0xff, 0xff, 0xff, 0xff, 0xff, 0xff,
    0xff, 0xff, 0xff, 0xff, 0xff, 0xff, 0xff, 0xff, 0xff, 0xff, 0xff, 0xff, 0xff, 0xff, 0xff, 0xff,
    0xff, 0xff, 0xff, 0xff, 0xff, 0xff, 0xff, 0xff, 0xff, 0xff, 0xff, 0xff, 0xff, 0xff, 0xff, 0xff,
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    0xff, 0xff, 0xff, 0xff, 0xff, 0xff, 0xff, 0xff, 0xff, 0xff, 0xff, 0xff, 0xff, 0xff, 0xff, 0xff};

// 'เอามือมาใกล้', 128x64px
const unsigned char epd_bitmap_nearhand[] PROGMEM = {
    0xff, 0xff, 0xff, 0xff, 0xff, 0xff, 0xff, 0xff, 0xff, 0xff, 0xff, 0xff, 0xff, 0xff, 0xff, 0xff,
    0xff, 0xff, 0xff, 0xff, 0xff, 0xff, 0xff, 0xff, 0xff, 0xff, 0xff, 0xff, 0xff, 0xff, 0xff, 0xff,
    0xff, 0xff, 0xff, 0xff, 0xff, 0xff, 0xff, 0xff, 0xff, 0xff, 0xff, 0xff, 0xff, 0xff, 0xff, 0xff,
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    0xff, 0xff, 0xff, 0xff, 0xff, 0xff, 0xff, 0xff, 0xff, 0xff, 0xff, 0xff, 0xff, 0xff, 0xff, 0xff};

void startMelody()
{
    currentNote = 0;
    is_new_note = true;
    melody_status = true;
    start_melody_time = millis();
    is_tone_playing = true;
}

void playMelody()
{
    if (!melody_status || currentNote >= num_notes)
        return;

    unsigned long elapsedTime = millis() - start_melody_time;

    // ถ้าเป็นโน้ตใหม่ ให้เริ่มเล่น tone จะได้ไม่โดนสั่งให้เล่นโทนทุกครั้งที่ loop
    if (is_new_note)
    {
        tone(BUZZER_PIN, notes[currentNote]);
        is_new_note = false;
        is_tone_playing = true;
    }

    if (elapsedTime >= duration[currentNote] && is_tone_playing)
    {
        noTone(BUZZER_PIN); // พัก 50ms
        is_tone_playing = false;
    }

    if (elapsedTime >= duration[currentNote] + 50)
    {
        currentNote++;                // เปลี่ยนโน้ตใหม่
        start_melody_time = millis(); // รีเซ็ตเวลา
        is_new_note = true;
        is_tone_playing = true;
    }
}

void setup()
{
    Serial.begin(115200);
    display.begin(0x3C, true); // เริ่มต้น OLED ที่ I2C Address 0x3C
    display.clearDisplay();
    Serial.println("Soil Moisture Sensor Test");
    pinMode(TRIG_PIN, OUTPUT);
    pinMode(ECHO_PIN, INPUT);
    pinMode(BUZZER_PIN, OUTPUT);
    // สั่งให้เล่นเพลง
    startMelody();
}

void loop()
{
    // ทำงานทุกๆ 1 วินาที
    if (millis() - last_time >= 1000)
    {
        last_time = millis();
        // อ่านค่าความชื้นในดิน
        int soilMoistureValue = analogRead(SOIL_SENSOR_PIN);
        // แปลงค่าความชื้นให้อยู่ในรูปเปอร์เซ็นต์
        int moisturePercent = map(soilMoistureValue, DRY_VALUE, WET_VALUE, 0, 100);
        // จำกัดค่าที่อ่านให้อยู่ในช่วง 0 ถึง 100%
        moisturePercent = constrain(moisturePercent, 0, 100);

        // ระบุสถานะของดิน และ กำหนดภาพสถานะ
        String soilStatus;
        if (moisturePercent <= 20)
        {
            soilStatus = "Dry (ดินแห้งมาก)";
            display_image = 7;
        }
        else if (moisturePercent > 20 && moisturePercent <= 40)
        {
            soilStatus = "Dry (ดินแห้ง)";
            display_image = 6;
        }
        else if (moisturePercent > 40 && moisturePercent <= 60)
        {
            soilStatus = "Moderate (ความชื้นปานกลาง)";
            display_image = 4;
        }
        else if (moisturePercent > 60 && moisturePercent <= 80)
        {
            soilStatus = "Moist (ดินชื้น)";
            display_image = 1;
        }
        else
        {
            soilStatus = "Wet (ดินเปียกหรืออิ่มตัว)";
            display_image = 3;
        }

        // แสดงผลใน Serial Monitor
        Serial.print("Soil Moisture Value (Raw): ");
        Serial.println(soilMoistureValue);

        Serial.print("Soil Moisture (%): ");
        Serial.print(moisturePercent);
        Serial.println("%");

        Serial.print("Soil Status: ");
        Serial.println(soilStatus);
        display.clearDisplay();

        // แสดงภาพสถานะ
        if (display_image == 1)
        {
            display.drawBitmap(0, 0, epd_bitmap_yummy, 128, 64, SH110X_WHITE);
        }
        else if (display_image == 2)
        {
            display.drawBitmap(0, 0, epd_bitmap_love, 128, 64, SH110X_WHITE);
        }
        else if (display_image == 3)
        {
            display.drawBitmap(0, 0, epd_bitmap_bigsmile, 128, 64, SH110X_WHITE);
        }
        else if (display_image == 4)
        {
            display.drawBitmap(0, 0, epd_bitmap_smilewithbrow, 128, 64, SH110X_WHITE);
        }
        else if (display_image == 5)
        {
            display.drawBitmap(0, 0, epd_bitmap_crying, 128, 64, SH110X_WHITE);
        }
        else if (display_image == 6)
        {
            display.drawBitmap(0, 0, epd_bitmap_worry, 128, 64, SH110X_WHITE);
        }
        else if (display_image == 7)
        {
            display.drawBitmap(0, 0, epd_bitmap_angry, 128, 64, SH110X_WHITE);
        }
        else if (display_image == 8)
        {
            display.drawBitmap(0, 0, epd_bitmap_nearhand, 128, 64, SH110X_WHITE);
        }

        display.display(); // อัปเดตหน้าจอ
    }

    if (melody_status == true)
    {
        playMelody();
    }
}
